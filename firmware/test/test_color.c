/* Color engine test: the C port must reproduce the browser implementation's
 * outputs exactly (integer RGB, glow within 1e-3, identical RGBW split).
 * Fixtures generated by firmware/tools/make_color_fixtures.js from index.html.
 */
#include "../src/color_engine.h"
#include "../src/render.h"
#include <math.h>
#include <stdio.h>
#include <stdlib.h>

static int failures = 0;

int main(void) {
    FILE *f = fopen("color_fixtures.txt", "r");
    if (!f) { fprintf(stderr, "color_fixtures.txt missing (run tools/make_color_fixtures.js)\n"); return 2; }
    int n;
    if (fscanf(f, "%d\n", &n) != 1) return 2;
    int bad_rgb = 0, bad_glow = 0, bad_rgbw = 0, bad_mode = 0;
    double worst_glow = 0;
    for (int i = 0; i < n; i++) {
        double s, m, il, doy, dec; int palette_on, ref_mode;
        int rr, gg, bb, wr, wg, wb, ww;
        double glow;
        if (fscanf(f, "%lf %lf %lf %lf %lf %d %d %d %d %d %lf %d %d %d %d\n",
                   &s, &m, &il, &doy, &dec, &palette_on, &ref_mode,
                   &rr, &gg, &bb, &glow, &wr, &wg, &wb, &ww) != 15) {
            printf("FAIL: parse\n"); failures++; break;
        }
        orb_rgb_t peak = orb_seasonal_peak((int)doy, dec, palette_on);
        orb_result_t r = orb_color(s, m, il, peak, 45);
        if (r.mode != ref_mode) bad_mode++;
        if (abs((int)(r.color.r + 0.5) - rr) > 0 || abs((int)(r.color.g + 0.5) - gg) > 0 ||
            abs((int)(r.color.b + 0.5) - bb) > 0) bad_rgb++;
        double dg = fabs(r.glow - glow);
        if (dg > worst_glow) worst_glow = dg;
        if (dg > 1e-3) bad_glow++;
        int cr, cg, cb, cw;
        orb_rgb_to_rgbw(r.color, r.glow, 0.40, &cr, &cg, &cb, &cw);
        if (cr != wr || cg != wg || cb != wb || cw != ww) bad_rgbw++;
    }
    fclose(f);

    printf("%s: color engine RGB matches browser (%d/%d mismatches)\n", bad_rgb ? "FAIL" : "PASS", bad_rgb, n);
    printf("%s: mode matches browser (%d mismatches)\n", bad_mode ? "FAIL" : "PASS", bad_mode);
    printf("%s: glow within 1e-3 of browser (worst %.5f)\n", bad_glow ? "FAIL" : "PASS", worst_glow);
    printf("%s: RGBW split + 40%% cap matches browser (%d mismatches)\n", bad_rgbw ? "FAIL" : "PASS", bad_rgbw);
    if (bad_rgb || bad_mode || bad_glow || bad_rgbw) failures++;
    printf(failures == 0 ? "\nALL PASS\n" : "\n%d FAILURE GROUP(S)\n", failures);
    return failures == 0 ? 0 : 1;
}
